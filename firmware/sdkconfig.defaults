## firmware/sdkconfig.defaults
```kconfig
# USB CDC 串口（ESP32-S3 原生 USB，不需要额外 USB-Serial 芯片）
CONFIG_ESP_CONSOLE_USB_CDC=y
CONFIG_USB_CDC_ENABLED=y

# 提高串口缓冲
CONFIG_ESP_CONSOLE_UART_BAUDRATE=115200

# ESP-SR WakeNet
CONFIG_SR_WN_WN9_HILEXIN=y   # 使用内置唤醒词模型（自定义"伍尔夫"需替换）
CONFIG_USE_AFE_SR=y

# ADC 校准
CONFIG_ADC_CAL_EFUSE_TP_ENABLE=y
CONFIG_ADC_CAL_LUT_ENABLE=y

# FreeRTOS tick
CONFIG_FREERTOS_HZ=1000
```
